## drivers/misc/Kconfig.mcux_flexio
```kconfig
# Copyright (c) 2022, STRIM, ALC
# SPDX-License-Identifier: Apache-2.0

config MCUX_FLEXIO
	bool
	depends on HAS_MCUX_FLEXIO
	depends on CLOCK_CONTROL
	help
	  Enable the FlexIO for SPI instances.
	  FlexIO is not used separately.
	  
```

## drivers/spi/Kconfig.mcux_flexio
```kconfig
# Copyright (c) 2022, STRIM, ALC
# SPDX-License-Identifier: Apache-2.0

config SPI_MCUX_FLEXIO
	bool "MCUX FlexIO SPI driver"
	depends on HAS_MCUX_FLEXIO
	depends on CLOCK_CONTROL
	select MCUX_FLEXIO
	help
	  Enable support for MCUX FlexIO SPI driver.
	  
```

## dts/bindings/misc/nxp,imx-flexio.yaml
```yaml
# Copyright (c) 2021, STRIM, ALC
# SPDX-License-Identifier: Apache-2.0

description: NXP i.MX FlexIO controller

compatible: "nxp,imx-flexio"

include: base.yaml

properties:
    reg:
      required: true

    interrupts:
      required: true

    clocks:
      required: true
```

## dts/bindings/spi/nxp,imx-flexio-spi.yaml
```yaml
# Copyright (c) 2021, STRIM, ALC
# SPDX-License-Identifier: Apache-2.0

description: NXP i.MX FlexIO SPI controller

compatible: "nxp,imx-flexio-spi"

include: [spi-controller.yaml, pinctrl-device.yaml]

properties:
    shifters:
      type: array
      required: true
      description: |
        Shifter index used in FlexIO SPI. 
        Two shifters should be described for SPI.

    timers:
      type: array
      required: true
      description: |
        Timer index used in FlexIO SPI. 
        Two timers should be described for SPI.

    sdo-pin:
      type: int
      required: true
      description: |
        Pin select for data output.

    sdi-pin:
      type: int
      required: true
      description: |
        Pin select for data input.

    sck-pin:
      type: int
      required: true
      description: |
        Pin select for clock.

    cs-pin:
      type: int
      required: true
      description: |
        Pin select for enable. Not really used, but need for HAL.
```
